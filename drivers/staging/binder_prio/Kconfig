## drivers/staging/binder_prio/Kconfig
```kconfig
config BINDER_PRIO
	tristate "Begonia binder priority optimization"
	default y
	help
	  Boosts select binder transaction targets to SCHED_FIFO during
	  synchronous transactions (MediaTek begonia/MIUI adaptation of
	  Xiaomi's binder_prio). Requires Android vendor binder hooks.
```
